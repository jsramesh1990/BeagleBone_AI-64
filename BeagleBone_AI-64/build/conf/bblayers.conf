## BeagleBone_AI-64/sources/meta-custom/conf/machine/bbbai64.conf
```bitbake
# Machine configuration for BeagleBone Black AI-64

# ============================================================================
# Machine Identification
# ============================================================================
#@TYPE: Machine
#@NAME: BeagleBone Black AI-64
#@SOC: j721e
#@DESCRIPTION: Machine configuration for the BeagleBone Black AI-64 board

# ============================================================================
# Include Base Configuration
# ============================================================================
require conf/machine/include/ti-soc.inc
require conf/machine/include/bbbai64.inc

# ============================================================================
# Machine Features
# ============================================================================
MACHINE_FEATURES:append = " \
    bbbai64 \
    ai \
    ml \
    gpu \
    camera \
    display \
    audio \
    sensors \
    pci \
    "

# ============================================================================
# Kernel Configuration
# ============================================================================
PREFERRED_PROVIDER_virtual/kernel = "linux-ti"
PREFERRED_VERSION_linux-ti = "6.1%"

# Kernel device tree
KERNEL_DEVICETREE = " \
    ti/k3-j721e-beagleboneai64.dtb \
    ti/k3-j721e-beagleboneai64-imx219.dtbo \
    ti/k3-j721e-beagleboneai64-ov5640.dtbo \
    ${@bb.utils.contains('MACHINE_FEATURES', 'display', 'ti/k3-j721e-beagleboneai64-hdmi.dtbo', '', d)} \
    "

# Kernel configuration fragments
KERNEL_CONFIG_FRAGMENTS:append = " \
    ${@bb.utils.contains('MACHINE_FEATURES', 'ai', '${S}/arch/arm64/configs/bbbai64-ai.cfg', '', d)} \
    ${@bb.utils.contains('MACHINE_FEATURES', 'sensors', '${S}/arch/arm64/configs/bbbai64-sensors.cfg', '', d)} \
    "

# ============================================================================
# U-Boot Configuration
# ============================================================================
PREFERRED_PROVIDER_virtual/bootloader = "u-boot-ti"
PREFERRED_VERSION_u-boot-ti = "2023.04%"

# ============================================================================
# Boot Configuration
# ============================================================================
# Boot device
BOOT_DEVICE = "mmcblk1"

# Kernel image
KERNEL_IMAGETYPE = "Image"

# ============================================================================
# Device Tree Overlays
# ============================================================================
# Enable device tree overlays for sensors and peripherals
BBBAI64_OVERLAYS:append = " \
    BB-BONE-AI-64-00A0.dtbo \
    BB-BONE-AI-64-SENSORS-00A0.dtbo \
    BB-BONE-AI-64-DISPLAY-00A0.dtbo \
    "

# ============================================================================
# Hardware Specific Settings
# ============================================================================
# I2C buses
I2C_BUSES = "0 1 2 3 4 5"

# SPI buses
SPI_BUSES = "0 1"

# GPIO pins
GPIO_PINS = "0-127"

# ============================================================================
# End of bbbai64.conf
# ============================================================================
```

## yocto-platform/layers/meta-distro/conf/distro/platform.conf
```bitbake
# layers/meta-distro/conf/distro/platform.conf
require conf/distro/poky.conf

DISTRO = "platform"
DISTRO_NAME = "Platform Linux Distribution"
DISTRO_VERSION = "1.0"
DISTRO_CODENAME = "stable"

# Init system
INIT_MANAGER = "systemd"
VIRTUAL-RUNTIME_init_manager = "systemd"
VIRTUAL-RUNTIME_initscripts = ""

# Package feeds
PACKAGE_FEED_URIS = "http://feeds.platform.com/${DISTRO}/${DISTRO_VERSION}"

# Security features
DISTRO_FEATURES:append = " acl pam seccomp"
DISTRO_FEATURES:remove = "x11"

# Additional features
DISTRO_FEATURES:append = " systemd opengl pci usbhost"
POKY_DEFAULT_DISTRO_FEATURES:append = " virtualization"

# Image features
IMAGE_FEATURES:append = " ssh-server-openssh package-management"

# Language support
IMAGE_LINGUAS = "en-us"

# License handling
LICENSE_FLAGS_ACCEPTED = "commercial"
```

## yocto-platform/layers/meta-distro/conf/machine/imx8mmevk.conf
```bitbake
# layers/meta-distro/conf/machine/imx8mmevk.conf
#@TYPE: Machine
#@NAME: NXP i.MX8M Mini EVK
#@SOC: imx8mm
#@DESCRIPTION: Machine configuration for NXP i.MX8M Mini EVK

require conf/machine/include/imx-base.inc
require conf/machine/include/tune-cortexa53.inc

MACHINE = "imx8mmevk"

MACHINE_FEATURES += "rtc"

# Kernel
PREFERRED_PROVIDER_virtual/kernel = "linux-imx"
KERNEL_DEVICETREE = "freescale/fsl-imx8mm-evk.dtb"

# U-Boot
UBOOT_MACHINE = "imx8mm_evk_config"
UBOOT_SUFFIX = "bin"

# Boot device
BOOT_SPACE = "65536"
IMAGE_BOOTLOADER = "imx-boot"

# Storage
SDCARD_ROOTFS_TYPE = "ext4"
```

## yocto-platform/layers/meta-distro/conf/machine/raspberrypi5.conf
```bitbake
# layers/meta-distro/conf/machine/raspberrypi5.conf
#@TYPE: Machine
#@NAME: Raspberry Pi 5
#@SOC: bcm2712
#@DESCRIPTION: Machine configuration for Raspberry Pi 5

require conf/machine/include/arm/armv8a/tune-cortexa76.inc

MACHINE = "raspberrypi5"

# Include Raspberry Pi BSP
require inc/raspberrypi.inc
require inc/raspberrypi5.inc

MACHINE_FEATURES += "bluetooth wifi"

# Kernel
PREFERRED_PROVIDER_virtual/kernel = "linux-raspberrypi"
KERNEL_DEVICETREE = "broadcom/bcm2712-rpi-5-b.dtb"

# U-Boot
UBOOT_MACHINE = "rpi_arm64_config"
PREFERRED_PROVIDER_u-boot = "u-boot"

# Boot
RPI_USE_U_BOOT = "1"

# Serial console
SERIAL_CONSOLES = "115200;ttyAMA10"

# GPU memory
GPU_MEM = "76"
```

## yocto-platform/layers/meta-mylayer/conf/layer.conf
```bitbake
BBPATH .= ":${LAYERDIR}"
BBFILES += "\${LAYERDIR}/recipes-*/*/*.bb"
BBFILE_COLLECTIONS += "meta-mylayer"
BBFILE_PATTERN_meta-mylayer = "^${LAYERDIR}/"
LAYERDEPENDS_meta-mylayer = "core"
```

## yocto-platform/layers/meta-platform/conf/layer.conf
```bitbake
# layers/meta-platform/conf/layer.conf
BBPATH .= ":${LAYERDIR}"
BBFILES += "${LAYERDIR}/recipes-*/*/*.bb \
            ${LAYERDIR}/recipes-*/*/*.bbappend"

BBFILE_COLLECTIONS += "meta-platform"
BBFILE_PATTERN_meta-platform = "^${LAYERDIR}/"
BBFILE_PRIORITY_meta-platform = "5"

LAYERDEPENDS_meta-platform = "core"
LAYERSERIES_COMPAT_meta-platform = "kirkstone"

# Platform specific variables
PLATFORM_COMMON = "1"
```
